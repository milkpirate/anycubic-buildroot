## configs/anycubic_kobra_rockchip_rv1106g3_defconfig
```kconfig
BR2_arm=y
BR2_cortex_a7=y
BR2_TOOLCHAIN_BUILDROOT_UCLIBC=y
BR2_KERNEL_HEADERS_5_10=y
BR2_UCLIBC_CONFIG="$(BR2_EXTERNAL_ANYCUBIC_KOBRA_PATH)/sdk/packages/uclibc/uClibc-ng.config"
BR2_TOOLCHAIN_BUILDROOT_WCHAR=y
BR2_BINUTILS_VERSION_2_45_X=y
BR2_TOOLCHAIN_BUILDROOT_CXX=y
BR2_WGET="wget --passive-ftp -nd -t 3"
BR2_SVN="svn --non-interactive"
BR2_SCP="scp"
BR2_SFTP="sftp"
BR2_BACKUP_SITE="http://sources.buildroot.net"
BR2_GNU_MIRROR="http://ftpmirror.gnu.org"
BR2_OPTIMIZE_S=y
BR2_GLOBAL_PATCH_DIR="$(BR2_EXTERNAL_ANYCUBIC_KOBRA_PATH)/patches $(BR2_EXTERNAL_ANYCUBIC_KOBRA_PATH)/board/anycubic/kobra_rv1106/patches"
BR2_INIT_NONE=y
BR2_PACKAGE_BUSYBOX_CONFIG="$(BR2_EXTERNAL_ANYCUBIC_KOBRA_PATH)/busybox.config"
BR2_PACKAGE_BUSYBOX_SHOW_OTHERS=y
BR2_PACKAGE_UNZIP=y
BR2_PACKAGE_ZIP=y
BR2_PACKAGE_STRACE=y
BR2_PACKAGE_BINUTILS=y
BR2_PACKAGE_BINUTILS_TARGET=y
BR2_PACKAGE_DOS2UNIX=y
BR2_PACKAGE_GIT_CRYPT=y
BR2_PACKAGE_JO=y
BR2_PACKAGE_JQ=y
BR2_PACKAGE_LIBTOOL=y
BR2_PACKAGE_MAKE=y
BR2_PACKAGE_PATCH=y
BR2_PACKAGE_PKGCONF=y
BR2_PACKAGE_TREE=y
BR2_PACKAGE_YQ=y
BR2_PACKAGE_FBDUMP=y
BR2_PACKAGE_FBGRAB=y
BR2_PACKAGE_EVTEST=y
BR2_PACKAGE_ROCKCHIP_RKBIN=y
BR2_PACKAGE_LUA=y
BR2_PACKAGE_LUA_READLINE=y
BR2_PACKAGE_MICROPYTHON=y
BR2_PACKAGE_MICROPYTHON_LIB=y
BR2_PACKAGE_MONO=y
BR2_PACKAGE_PYTHON3=y
BR2_PACKAGE_PYTHON3_PY_PYC=y
BR2_PACKAGE_PYTHON3_CURSES=y
BR2_PACKAGE_PYTHON3_SSL=y
BR2_PACKAGE_PYTHON3_SQLITE=y
BR2_PACKAGE_PYTHON3_PYEXPAT=y
BR2_PACKAGE_PYTHON3_XZ=y
BR2_PACKAGE_PYTHON3_ZLIB=y
BR2_PACKAGE_CA_CERTIFICATES=y
BR2_PACKAGE_LIBSODIUM=y
BR2_PACKAGE_LIBOPENSSL_BIN=y
BR2_PACKAGE_FONTCONFIG=y
BR2_PACKAGE_LIBDRM=y
BR2_PACKAGE_LIBSVG=y
BR2_PACKAGE_PIXMAN=y
BR2_PACKAGE_TSLIB=y
BR2_PACKAGE_LIBCURL=y
BR2_PACKAGE_LIBCURL_CURL=y
BR2_PACKAGE_LIBVNCSERVER=y
BR2_PACKAGE_LIBEVENT=y
BR2_PACKAGE_MPC=y
BR2_PACKAGE_PCRE=y
BR2_PACKAGE_DROPBEAR=y
# BR2_PACKAGE_IFUPDOWN_SCRIPTS is not set
BR2_PACKAGE_IPTABLES=y
BR2_PACKAGE_IW=y
BR2_PACKAGE_LIGHTTPD=y
BR2_PACKAGE_LIGHTTPD_PCRE=y
BR2_PACKAGE_MJPG_STREAMER=y
BR2_PACKAGE_RSYNC=y
BR2_PACKAGE_SER2NET=y
BR2_PACKAGE_SOCAT=y
BR2_PACKAGE_STUNNEL=y
BR2_PACKAGE_TCPDUMP=y
BR2_PACKAGE_FILE=y
BR2_PACKAGE_NEOFETCH=y
BR2_PACKAGE_SCREEN=y
BR2_PACKAGE_TIME=y
BR2_PACKAGE_ANDROID_TOOLS=y
BR2_PACKAGE_HTOP=y
BR2_PACKAGE_UTIL_LINUX=y
BR2_PACKAGE_UTIL_LINUX_LIBUUID=y
BR2_PACKAGE_NANO=y
# BR2_TARGET_ROOTFS_TAR is not set
BR2_PACKAGE_HOST_ENVIRONMENT_SETUP=y
```

## configs/sdk_defconfig
```kconfig
BR2_arm=y
BR2_cortex_a7=y
BR2_TOOLCHAIN_BUILDROOT_VENDOR="anycubic_kobra_rockchip"
BR2_TOOLCHAIN_BUILDROOT_UCLIBC=y
BR2_KERNEL_HEADERS_5_10=y
BR2_UCLIBC_CONFIG="$(BR2_EXTERNAL_ANYCUBIC_KOBRA_PATH)/sdk/packages/uclibc/uClibc-ng.config"
BR2_TOOLCHAIN_BUILDROOT_LOCALE=y
BR2_PTHREAD_DEBUG=y
BR2_TOOLCHAIN_BUILDROOT_USE_SSP=y
BR2_BINUTILS_VERSION_2_45_X=y
BR2_BINUTILS_GPROFNG=y
BR2_GCC_VERSION_15_X=y
BR2_TOOLCHAIN_BUILDROOT_CXX=y
BR2_TOOLCHAIN_BUILDROOT_FORTRAN=y
BR2_GCC_ENABLE_OPENMP=y
BR2_GCC_ENABLE_GRAPHITE=y
BR2_PACKAGE_HOST_GDB=y
BR2_PACKAGE_HOST_GDB_TUI=y
BR2_PACKAGE_HOST_GDB_PYTHON3=y
BR2_PACKAGE_HOST_GDB_SIM=y
BR2_GDB_VERSION_16=y
BR2_WGET="wget --passive-ftp -nd -t 3"
BR2_SVN="svn --non-interactive"
BR2_SCP="scp"
BR2_SFTP="sftp"
BR2_BACKUP_SITE="http://sources.buildroot.net"
BR2_GNU_MIRROR="http://ftpmirror.gnu.org"
BR2_OPTIMIZE_S=y
BR2_ENABLE_LTO=y
BR2_SHARED_STATIC_LIBS=y
BR2_GLOBAL_PATCH_DIR="$(BR2_EXTERNAL_ANYCUBIC_KOBRA_PATH)/patches"
BR2_INIT_NONE=y
BR2_SYSTEM_BIN_SH_NONE=y
# BR2_PACKAGE_BUSYBOX is not set
BR2_PACKAGE_BINUTILS=y
BR2_PACKAGE_HOST_ENVIRONMENT_SETUP=y
BR2_PACKAGE_HOST_RUSTC=y
```
